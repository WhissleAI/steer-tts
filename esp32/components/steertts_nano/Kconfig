## esp32/components/steertts_nano/Kconfig
```kconfig
menu "SteerTTS Nano"
config NANO_BENCH_SECONDS
    int "Seconds of audio to synthesize"
    default 10
config NANO_BENCH_TASK_STACK
    int "Benchmark task stack (bytes)"
    default 12288
endmenu
```

## esp32/sdkconfig.defaults
```kconfig
# ESP32-S3, 8 MB flash, no PSRAM
CONFIG_IDF_TARGET="esp32s3"
CONFIG_ESPTOOLPY_FLASHSIZE_8MB=y
CONFIG_ESPTOOLPY_FLASHMODE_QIO=y
CONFIG_ESPTOOLPY_FLASHFREQ_80M=y
CONFIG_PARTITION_TABLE_CUSTOM=y
CONFIG_PARTITION_TABLE_CUSTOM_FILENAME="partitions.csv"
CONFIG_ESP_DEFAULT_CPU_FREQ_MHZ_240=y
CONFIG_ESP32S3_DEFAULT_CPU_FREQ_240=y
CONFIG_SPIRAM=n
CONFIG_COMPILER_OPTIMIZATION_PERF=y
CONFIG_ESP_MAIN_TASK_STACK_SIZE=8192
CONFIG_ESP32S3_DATA_CACHE_64KB=y
CONFIG_ESP32S3_DATA_CACHE_LINE_64B=y
CONFIG_FREERTOS_USE_TRACE_FACILITY=y
CONFIG_ESP_TASK_WDT_TIMEOUT_S=30
```
